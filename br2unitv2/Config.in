## br2unitv2/Config.in
```kconfig
source "$BR2_EXTERNAL_UNITV2_PATH/package/rtl8188fu/Config.in"

config BR2_BOARD_UNITV2
	bool "unit v2"
	depends on BR2_arm
	select BR2_LINUX_KERNEL
	select BR2_PACKAGE_DNSMASQ
	select BR2_PACKAGE_SANETIME
	select BR2_PACKAGE_RTL8188FU
	select BR2_PACKAGE_WIRELESS_REGDB
	select BR2_PACKAGE_WPA_SUPPLICANT
	select BR2_PACKAGE_HOST_GENIMAGE
	select BR2_PACKAGE_HOST_UBOOT_TOOLS
	select BR2_PACKAGE_HOST_UBOOT_TOOLS_FIT_SUPPORT
	select BR2_PACKAGE_HOST_UBOOT_TOOLS_FIT_SIGNATURE_SUPPORT
	select BR2_GCC_ENABLE_LTO
	select BR2_LINUX_KERNEL_CUSTOM_GIT
	select BR2_LINUX_KERNEL_USE_CUSTOM_CONFIG
	select BR2_LINUX_KERNEL_XZ
	select BR2_LINUX_KERNEL_DTS_SUPPORT
	select BR2_PACKAGE_MTD
	help
	  Unit V2 support

config BR2_BOARD_UNITV2_MAIN
	bool "unit v2 main"
	depends on BR2_BOARD_UNITV2
	select BR2_TARGET_UBOOT
	select BR2_TARGET_UBOOT_NEEDS_DTC
	select BR2_TARGET_UBOOT_SPL
	select BR2_TARGET_UBOOT_FORMAT_IMG
	select BR2_TARGET_ROOTFS_SQUASHFS

config BR2_BOARD_UNITV2_RESCUE
	bool "unit v2 rescue"
	depends on BR2_BOARD_UNITV2
	select BR2_PACKAGE_LRZSZ
	select BR2_TARGET_ROOTFS_CPIO
	select BR2_TARGET_ROOTFS_CPIO_LZ4

if BR2_BOARD_UNITV2

# System config
config BR2_TARGET_GENERIC_HOSTNAME
	default "unitv2"

config BR2_ROOTFS_POST_IMAGE_SCRIPT
	default "support/scripts/genimage.sh"

config BR2_ROOTFS_OVERLAY
	default "$(BR2_EXTERNAL_UNITV2_PATH)/board/m5stack/unitv2/overlay/"

# Default u-boot opts
config BR2_TARGET_UBOOT_BOARD_DEFCONFIG
	default "mstar_infinity2m_unitv2"

config BR2_TARGET_UBOOT_SPL_NAME
	default "ipl"

# Default kernel opts
config BR2_LINUX_KERNEL_CUSTOM_REPO_URL
	default "https://github.com/linux-chenxing/linux.git"

config BR2_LINUX_KERNEL_CUSTOM_REPO_VERSION
	default "mstar_v5_18_rebase"

config BR2_LINUX_KERNEL_CUSTOM_CONFIG_FILE
	default "$(BR2_EXTERNAL_UNITV2_PATH)/board/m5stack/unitv2/linux.config"

config BR2_LINUX_KERNEL_DTS_SUPPORT
	default y

config BR2_LINUX_KERNEL_INTREE_DTS_NAME
	default "mstar-infinity2m-ssd202d-unitv2"

#

endif
```

## br2unitv2/board/m5stack/unitv2/kernel_rescue.its
```
/dts-v1/;

/ {
	description = "M5Stack UnitV2";
	#address-cells = <1>;

	images {
		kernel@0 {
			data = /incbin/("../../images/zImage");
			type = "kernel";
			arch = "arm";
			os = "linux";
			compression = "none";
			load = <0x21800000>;
                        entry = <0x21800000>;
			hash@1 {
				algo = "crc32";
			};
			hash@2 {
				algo = "sha1";
			};
		};
		fdt_unitv2 {
			data = /incbin/("../../images/mstar-infinity2m-ssd202d-unitv2.dtb");
			type = "flat_dt";
			arch = "arm";
			compression = "none";
			hash@1 {
				algo = "crc32";
			};
			hash@2 {
				algo = "sha1";
			};
		};
		ramdisk@0 {
			data = /incbin/("../../images/rootfs.cpio.lz4");
			type = "ramdisk";
			arch = "arm";
			os = "linux";
			compression = "none";
			hash@1 {
				algo = "crc32";
			};
			hash@2 {
				algo = "sha1";
			};
		};
	};

	configurations {
		default = "unitv2";
		unitv2 {
			kernel = "kernel@0";
			fdt = "fdt_unitv2";
			ramdisk = "ramdisk@0";
		};
	};
};
```

## br2unitv2/configs/unitv2_rescue_defconfig
```kconfig
BR2_arm=y
BR2_cortex_a7=y
BR2_ARM_FPU_NEON_VFPV4=y
BR2_REPRODUCIBLE=y
# BR2_PIC_PIE is not set
BR2_SSP_NONE=y
BR2_RELRO_NONE=y
BR2_TOOLCHAIN_BUILDROOT_MUSL=y
BR2_BINUTILS_VERSION_2_37_X=y
BR2_GCC_VERSION_11_X=y
# BR2_TARGET_GENERIC_REMOUNT_ROOTFS_RW is not set
BR2_ROOTFS_OVERLAY="$(BR2_EXTERNAL_UNITV2_PATH)/board/m5stack/unitv2/overlay/"
BR2_ROOTFS_POST_IMAGE_SCRIPT="support/scripts/genimage.sh"
BR2_ROOTFS_POST_SCRIPT_ARGS="-c $(BR2_EXTERNAL_UNITV2_PATH)/board/m5stack/unitv2/genimage_rescue.cfg"
BR2_LINUX_KERNEL_CUSTOM_GIT=y
BR2_LINUX_KERNEL_USE_CUSTOM_CONFIG=y
BR2_LINUX_KERNEL_CONFIG_FRAGMENT_FILES="$(BR2_EXTERNAL_UNITV2_PATH)/board/m5stack/unitv2/kernel_rescue.fragment"
BR2_LINUX_KERNEL_XZ=y
# BR2_PACKAGE_MTD_FLASHCP is not set
# BR2_PACKAGE_MTD_FLASH_LOCK is not set
# BR2_PACKAGE_MTD_FLASH_UNLOCK is not set
# BR2_PACKAGE_MTD_MTD_DEBUG is not set
# BR2_PACKAGE_MTD_NANDDUMP is not set
# BR2_PACKAGE_MTD_NANDTEST is not set
# BR2_PACKAGE_MTD_MTDINFO is not set
BR2_PACKAGE_LIBGPIOD=y
BR2_PACKAGE_LIBGPIOD_TOOLS=y
BR2_TARGET_ROOTFS_CPIO_LZ4=y
# BR2_TARGET_ROOTFS_TAR is not set
BR2_BOARD_UNITV2=y
BR2_BOARD_UNITV2_RESCUE=y
```

## br2unitv2/package/rtl8188fu/Config.in
```kconfig
config BR2_PACKAGE_RTL8188FU
	bool "rtl8188fu"
	depends on BR2_LINUX_KERNEL
	help
	  A standalone driver for the RTL8188FU USB Wi-Fi adapter.

comment "rtl8188fu needs a Linux kernel to be built"
	depends on !BR2_LINUX_KERNEL
```
